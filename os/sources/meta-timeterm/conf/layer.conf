## os/sources/meta-timeterm/conf/layer.conf
```bitbake
# We have a conf and classes directory, add to BBPATH
BBPATH .= ":${LAYERDIR}"

# We have recipes-* directories, add to BBFILES
BBFILES += "${LAYERDIR}/recipes-*/*/*.bb \
            ${LAYERDIR}/recipes-*/*/*.bbappend"

BBFILE_COLLECTIONS += "meta-timeterm"
BBFILE_PATTERN_meta-timeterm = "^${LAYERDIR}/"
BBFILE_PRIORITY_meta-timeterm = "10"

LAYERDEPENDS_meta-timeterm = "core"
LAYERSERIES_COMPAT_meta-timeterm = "warrior zeus"

LAYERVERSION_meta-timeterm = "1"

HOSTTOOLS += "git-lfs"

IMAGE_INSTALL += "frontend-embedded"
```
